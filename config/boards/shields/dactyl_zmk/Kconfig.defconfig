## config/boards/shields/dactyl_zmk/Kconfig.defconfig
```kconfig
if SHIELD_DACTYL_ZMK_LEFT

config ZMK_KEYBOARD_NAME
    default "Dactyl ZMK"

config ZMK_SPLIT_ROLE_CENTRAL
    default y

endif

if SHIELD_DACTYL_ZMK_LEFT || SHIELD_DACTYL_ZMK_RIGHT

config ZMK_SPLIT
    default y

endif
```

## config/boards/shields/dactyl_zmk/Kconfig.shield
```kconfig
config SHIELD_DACTYL_ZMK_LEFT
    def_bool $(shields_list_contains,dactyl_zmk_left)

config SHIELD_DACTYL_ZMK_RIGHT
    def_bool $(shields_list_contains,dactyl_zmk_right)
```
